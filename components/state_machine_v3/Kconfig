## components/state_machine_v3/Kconfig
```kconfig
menu "State Machine V3 Configuration"

    config STATE_MACHINE_V3_ENABLE
        bool "Enable State Machine V3"
        default y
        help
            Enable the V3 state machine implementation with condition-based
            triggers and enhanced JSON configuration.

    config STATE_MACHINE_V3_TEST
        bool "Enable V3 State Machine Tests (STEM)"
        default n
        depends on STATE_MACHINE_V3_ENABLE
        help
            Enable simplified test suite for STEM education:
            - 基础测试: 初始化、配置加载、触发器、定时器
            - 电梯场景: 升降机逻辑、安全互锁
            - 模块类型: 按钮、LED、电机
            
            使用 Unity 测试框架，专注 ESP32 平台。

    config STATE_MACHINE_V3_LOG_LEVEL
        int "V3 State Machine Log Level"
        default 3
        range 0 5
        help
            Log level for V3 state machine (0=NONE, 5=VERBOSE)

endmenu
```

## components/wifi_manager/Kconfig
```kconfig
menu "WiFi Manager Configuration"

    config WIFI_DEFAULT_SSID
        string "Default WiFi SSID"
        default ""
        help
            Default WiFi SSID to connect to when no NVS configuration exists.
            Leave empty to require explicit configuration.

    config WIFI_DEFAULT_PASSWORD
        string "Default WiFi Password"
        default ""
        help
            Default WiFi password. Leave empty for open networks.

    config WIFI_AP_SSID
        string "AP Mode SSID"
        default ""
        help
            SSID for AP mode (configuration hotspot).

    config WIFI_AP_PASSWORD
        string "AP Mode Password"
        default ""
        help
            Password for AP mode. Minimum 8 characters.

endmenu
```

## main/Kconfig.projbuild
```kconfig
menu "WiFi Configuration"

    config WIFI_DEFAULT_SSID
        string "默认WiFi SSID"
        default "XINGHUI"
        help
            设备未配置WiFi时使用的默认SSID。
            用户可通过POST /api/wifi/config接口修改配置。

    config WIFI_DEFAULT_PASSWORD
        string "默认WiFi密码"
        default "88888888"
        help
            设备未配置WiFi时使用的默认密码。
            可为空字符串表示开放网络（无密码）。

endmenu
```

## sdkconfig.defaults
```kconfig
# WiFi默认配置
# 主任务栈大小 (8KB - 支持精简状态机配置)
CONFIG_ESP_MAIN_TASK_STACK_SIZE=8192

# STA模式默认配置（连接路由器）
CONFIG_WIFI_DEFAULT_SSID="XINGHUI"
CONFIG_WIFI_DEFAULT_PASSWORD="88888888"

# AP模式默认配置（配网热点）
CONFIG_WIFI_AP_SSID="Yonovate-Setup"
CONFIG_WIFI_AP_PASSWORD="12345678"

# Flash 配置 (4MB)
CONFIG_ESPTOOLPY_FLASHSIZE_4MB=y

# Unity 测试框架通过 IDF_BUILD_TESTS 启用
```
